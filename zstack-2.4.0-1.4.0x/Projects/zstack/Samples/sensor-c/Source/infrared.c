/*********************************************************************************************
* 文件：infrared.c
* 作者：Lixm 2017.10.17
* 说明：PIR人体红外传感器驱动 — 实现
* 修改：[增强] 新增 GPIO 中断模式:
*          - infrared_int_init()    中断初始化
*          - infrared_int_enable()  中断使能
*          - infrared_int_disable() 中断禁止
*          - PIR ISR 回调           自动记录触发事件
* 注释：
*   PIR 传感器原理:
*   - HC-SR501 等 PIR 模块 OUT 引脚:
*     - 静态 (无人): 输出低电平 (0V)
*     - 触发 (有人靠近): 输出高电平 (3.3V), 持续 2~5 秒后自动回落
*   - 因此:
*     - 上升沿 = 有人靠近 (告警事件)
*     - 下降沿 = 人离开/超时
*
*   接线:
*   PIR VCC  → CC2530 3.3V
*   PIR GND  → CC2530 GND
*   PIR OUT  → CC2530 P0.0
*
*   中断 vs 轮询对比:
*   ┌──────────┬────────────────┬────────────────┐
*   │  模  式   │    优  点       │    缺  点       │
*   ├──────────┼────────────────┼────────────────┤
*   │ 轮询模式  │ 实现简单        │ CPU 持续消耗    │
*   │          │ 天然去抖        │ 可能漏检快速事件 │
*   ├──────────┼────────────────┼────────────────┤
*   │ 中断模式  │ 实时响应        │ ISR 需保持简短   │
*   │          │ CPU 空闲时休眠  │ 需软件去抖      │
*   └──────────┴────────────────┴────────────────┘
*********************************************************************************************/

/*********************************************************************************************
* 头文件
*********************************************************************************************/
#include "infrared.h"
#include "OSAL.h"        /* osal_GetSystemClock() — 去抖计时 */

/*********************************************************************************************
* 全局变量
*********************************************************************************************/

/* 中断模式状态 */
static pir_event_callback_t g_pir_callback = NULL;   /* 应用层回调 */
static void                *g_pir_userdata  = NULL;   /* 回调用户数据 */
static volatile uint16      g_pir_int_count = 0;      /* 中断触发计数器 */
static volatile uint32      g_pir_last_time = 0;      /* 上次中断触发时间 (去抖) */
static volatile uint8       g_pir_int_mode  = 0;      /* 1 = 中断模式已初始化 */

/*********************************************************************************************
* 名称：_pir_int_handler()
* 功能：PIR 中断内部处理函数 (由 gpio_int ISR 回调)
* 参数：pin    — 触发引脚索引 (0)
*       level  — 当前引脚电平
*       pdata  — 用户数据
* 返回：无
* 修改：
* 注释：此函数在 ISR 上下文中执行，必须保持简短！
*       主要完成: 硬件去抖判断 → 触发计数器+1 → 调用应用回调
*       复杂处理 (如 ZigBee 上报) 应由应用层在 OSAL 事件中完成
*********************************************************************************************/
static void _pir_int_handler(uint8 pin, uint8 level, void *pdata)
{
    uint32 now;

    (void)pin;       /* 已知是 P0.0 */
    (void)pdata;     /* 保留 */

    /*
     * 硬件去抖:
     * 原理 — PIR 模块内部已有延时 (2~5s), 输出是干净的。
     * 但为防止电源噪声导致误触发, 增加 200ms 软件去抖窗口。
     * 两次中断间隔 < PIR_DEBOUNCE_MS (200ms) → 忽略
     */
    now = osal_GetSystemClock();
    if ((now - g_pir_last_time) < PIR_DEBOUNCE_MS) {
        return;  /* 去抖窗口内, 忽略 */
    }
    g_pir_last_time = now;

    /* 触发计数器 +1 */
    g_pir_int_count++;

    /*
     * 根据当前电平判断事件类型并回调应用层:
     *   level=1 → 上升沿/高电平 → 有人靠近
     *   level=0 → 下降沿/低电平 → 人离开/超时
     */
    if (g_pir_callback != NULL) {
        g_pir_callback(level, g_pir_userdata);
    }
}

/*********************************************************************************************
* ===== 轮询模式 API 实现 (保持原有逻辑 100% 兼容) =====
*********************************************************************************************/

/*********************************************************************************************
* 名称：infrared_init()
* 功能：PIR 传感器初始化 (轮询模式)
* 参数：无
* 返回：无
* 修改：
* 注释：原有实现 — 配置 P0.0 为通用 IO 输入
*********************************************************************************************/
void infrared_init(void)
{
    P0SEL &= ~0x01;        /* 设置管脚为通用IO模式 */
    P0DIR &= ~0x01;        /* 设置控制管脚为输入模式 */
}

/*********************************************************************************************
* 名称：get_infrared_status()
* 功能：读取 PIR 传感器状态 (轮询模式)
* 参数：无
* 返回：1 = 检测到人体信号, 0 = 无人
* 修改：
* 注释：原有实现 — 直接读取 P0.0 电平
*********************************************************************************************/
unsigned char get_infrared_status(void)
{
    if (P0_0)              /* PIR 传感器输出高电平 */
        return 1;          /* 检测到信号返回 1 */
    else
        return 0;          /* 没有检测到信号返回 0 */
}


/*********************************************************************************************
* ===== 中断模式 API 实现 (新增) =====
*********************************************************************************************/

/*********************************************************************************************
* 名称：infrared_int_init()
* 功能：初始化 PIR 传感器为 GPIO 中断模式
* 参数：callback — 应用层回调 (NULL = 仅计数, 不回调)
*       pdata    — 用户数据
* 返回：无
* 修改：[新增]
* 注释：
*   中断配置: P0.0, 下降沿触发
*   调用前需先调用 gpio_int_init_all() 全局初始化
*   与 infrared_init() 互斥 — 同一时刻只用一种模式
*********************************************************************************************/
void infrared_int_init(pir_event_callback_t callback, void *pdata)
{
    /* 保存应用层回调 */
    g_pir_callback = callback;
    g_pir_userdata = pdata;

    /* 初始化计数器 */
    g_pir_int_count = 0;
    g_pir_last_time = 0;

    /* 注册 GPIO 中断 — P0.0 下降沿触发 */
    gpio_int_init_pin(PIR_GPIO_PIN, PIR_INT_EDGE,
                      _pir_int_handler, NULL);

    g_pir_int_mode = 1;
}

/*********************************************************************************************
* 名称：infrared_int_enable()
* 功能：使能 PIR 中断检测
* 参数：无
* 返回：无
* 修改：[新增]
*********************************************************************************************/
void infrared_int_enable(void)
{
    if (g_pir_int_mode) {
        gpio_int_enable_pin(PIR_GPIO_PIN);
    }
}

/*********************************************************************************************
* 名称：infrared_int_disable()
* 功能：禁止 PIR 中断检测
* 参数：无
* 返回：无
* 修改：[新增]
*********************************************************************************************/
void infrared_int_disable(void)
{
    gpio_int_disable_pin(PIR_GPIO_PIN);
}

/*********************************************************************************************
* 名称：infrared_int_get_count()
* 功能：获取 PIR 中断触发累计次数
* 参数：无
* 返回：累计触发次数
* 修改：[新增]
*********************************************************************************************/
uint16 infrared_int_get_count(void)
{
    return g_pir_int_count;
}

/*********************************************************************************************
* 名称：infrared_int_reset_count()
* 功能：复位中断触发计数器
* 参数：无
* 返回：无
* 修改：[新增]
*********************************************************************************************/
void infrared_int_reset_count(void)
{
    g_pir_int_count = 0;
}
