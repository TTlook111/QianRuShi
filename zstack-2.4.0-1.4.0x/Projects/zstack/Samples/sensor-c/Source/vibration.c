/*********************************************************************************************
* 文件：vibration.c
* 作者：Lixm 2017.10.17
* 说明：震动传感器驱动 — 实现 (开门/敲门/震动/破坏检测)
* 修改：[增强] 新增 GPIO 中断模式:
*          - vibration_int_init()    中断初始化
*          - vibration_int_enable()  中断使能
*          - vibration_int_disable() 中断禁止
*          - 震动事件 ISR 回调       实时推送震动告警
* 注释：
*   震动传感器工作原理:
*   - 常开型震动开关: 无震动 → 高电平, 有震动 → 低电平脉冲
*   - 灵敏度可通过电位器调节
*
*   接线:
*   震动模块 VCC  → CC2530 3.3V
*   震动模块 GND  → CC2530 GND
*   震动模块 DO   → CC2530 P0.1 (数字输出)
*
*   安防场景:
*   - 敲门检测 → 门铃触发事件
*   - 暴力破坏检测 → 安防告警
*   - 结合 PIR 实现双重确认
*********************************************************************************************/

/*********************************************************************************************
* 头文件
*********************************************************************************************/
#include "vibration.h"
#include "OSAL.h"        /* osal_GetSystemClock() */

/*********************************************************************************************
* 全局变量
*********************************************************************************************/

/* 中断模式状态 */
static vib_event_callback_t  g_vib_callback  = NULL;
static void                 *g_vib_userdata  = NULL;
static volatile uint16       g_vib_int_count = 0;
static volatile uint32       g_vib_last_time = 0;
static volatile uint8        g_vib_int_mode  = 0;

/*********************************************************************************************
* 名称：_vibration_int_handler()
* 功能：震动传感器中断内部处理函数 (由 gpio_int ISR 回调)
* 参数：pin    — 触发引脚索引 (1)
*       level  — 当前引脚电平
*       pdata  — 用户数据
* 返回：无
* 修改：[新增]
* 注释：ISR 上下文 — 必须简短！
*********************************************************************************************/
static void _vibration_int_handler(uint8 pin, uint8 level, void *pdata)
{
    uint32 now;

    (void)pin;
    (void)pdata;

    /* 软件去抖 — 200ms 窗口 */
    now = osal_GetSystemClock();
    if ((now - g_vib_last_time) < VIB_DEBOUNCE_MS) {
        return;
    }
    g_vib_last_time = now;

    /* 计数器 +1 */
    g_vib_int_count++;

    /*
     * 回调应用层:
     *   level=0 → 震动触发 (低电平脉冲)
     *   level=1 → 震动结束 (恢复高电平)
     *   通常关注 level=0 的触发事件
     */
    if (g_vib_callback != NULL) {
        g_vib_callback(level, g_vib_userdata);
    }
}


/*********************************************************************************************
* ===== 轮询模式 API (保持原有逻辑 100% 兼容) =====
*********************************************************************************************/

/*********************************************************************************************
* 名称：vibration_init()
* 功能：震动传感器初始化 (轮询模式)
* 参数：无
* 返回：无
* 修改：
* 注释：原有实现 — 配置 P0.1 为通用 IO 输入
*********************************************************************************************/
void vibration_init(void)
{
    P0SEL &= ~0x02;        /* 设置管脚为通用IO模式 */
    P0DIR &= ~0x02;        /* 设置控制管脚为输入模式 */
}

/*********************************************************************************************
* 名称：get_vibration_status()
* 功能：读取震动传感器状态 (轮询模式)
* 参数：无
* 返回：VIB_STATE_TRIGGERED (1) = 有震动, VIB_STATE_IDLE (0) = 无震动
* 修改：
* 注释：原有实现 — P0.1 低电平表示检测到震动
*********************************************************************************************/
unsigned char get_vibration_status(void)
{
    if (P0_1)              /* 震动传感器输出高电平 → 无震动 */
        return VIB_STATE_IDLE;       /* 没有检测到信号返回 0 */
    else
        return VIB_STATE_TRIGGERED; /* 检测到信号返回 1 */
}


/*********************************************************************************************
* ===== 中断模式 API (新增) =====
*********************************************************************************************/

/*********************************************************************************************
* 名称：vibration_int_init()
* 功能：初始化震动传感器为 GPIO 中断模式
* 参数：callback — 震动事件回调
*       pdata    — 用户数据
* 返回：无
* 修改：[新增]
* 注释：中断配置: P0.1, 下降沿触发 (震动=低电平脉冲)
*********************************************************************************************/
void vibration_int_init(vib_event_callback_t callback, void *pdata)
{
    g_vib_callback  = callback;
    g_vib_userdata  = pdata;
    g_vib_int_count = 0;
    g_vib_last_time = 0;

    gpio_int_init_pin(VIB_GPIO_PIN, VIB_INT_EDGE,
                      _vibration_int_handler, NULL);
    g_vib_int_mode  = 1;
}

/*********************************************************************************************
* 名称：vibration_int_enable()
* 功能：使能震动中断检测
* 参数：无
* 返回：无
* 修改：[新增]
*********************************************************************************************/
void vibration_int_enable(void)
{
    if (g_vib_int_mode) {
        gpio_int_enable_pin(VIB_GPIO_PIN);
    }
}

/*********************************************************************************************
* 名称：vibration_int_disable()
* 功能：禁止震动中断检测
* 参数：无
* 返回：无
* 修改：[新增]
*********************************************************************************************/
void vibration_int_disable(void)
{
    gpio_int_disable_pin(VIB_GPIO_PIN);
}

/*********************************************************************************************
* 名称：vibration_int_get_count()
* 功能：获取震动中断触发累计次数
* 参数：无
* 返回：累计次数
* 修改：[新增]
*********************************************************************************************/
uint16 vibration_int_get_count(void)
{
    return g_vib_int_count;
}

/*********************************************************************************************
* 名称：vibration_int_reset_count()
* 功能：复位触发计数器
* 参数：无
* 返回：无
* 修改：[新增]
*********************************************************************************************/
void vibration_int_reset_count(void)
{
    g_vib_int_count = 0;
}
