/*********************************************************************************************
* 文件：Touch.c
* 作者：Lixm 2017.10.17
* 说明：TCH震动按键/触摸传感器驱动 — 实现
* 修改：[增强] 新增 GPIO 中断模式:
*          - touch_int_init()    中断初始化
*          - touch_int_enable()  中断使能
*          - touch_int_disable() 中断禁止
*          - 触摸事件 ISR 回调   实时推送门铃触发事件
* 注释：
*   TCH 触摸按键工作原理:
*   - 电容式触摸/震动按键: 人体触摸 → 电容变化 → 输出低电平脉冲
*   - 常开: 输出高电平, 触摸触发: 输出低电平
*
*   接线:
*   触摸模块 VCC  → CC2530 3.3V  (或独立按键上拉到 3.3V)
*   触摸模块 GND  → CC2530 GND
*   触摸模块 OUT  → CC2530 P0.0
*
*   ⚠️ 注意事项:
*   P0.0 引脚在 Mode=1 时为 PIR 红外传感器, Mode=2 时为触摸按键
*   两者分时复用 — 切换模式时需重新初始化对应驱动
*
*   门铃场景:
*   - 访客触摸/按压 → 中断触发 → 门铃事件 → ZigBee 上报 → 网关推送通知
*********************************************************************************************/

/*********************************************************************************************
* 头文件
*********************************************************************************************/
#include "Touch.h"
#include "OSAL.h"        /* osal_GetSystemClock() */

/*********************************************************************************************
* 全局变量
*********************************************************************************************/

/* 中断模式状态 */
static touch_event_callback_t g_touch_callback  = NULL;
static void                  *g_touch_userdata  = NULL;
static volatile uint16        g_touch_int_count = 0;
static volatile uint32        g_touch_last_time = 0;
static volatile uint8         g_touch_int_mode  = 0;

/*********************************************************************************************
* 名称：_touch_int_handler()
* 功能：触摸传感器中断内部处理函数 (由 gpio_int ISR 回调)
* 参数：pin    — 触发引脚索引 (0)
*       level  — 当前引脚电平
*       pdata  — 用户数据
* 返回：无
* 修改：[新增]
* 注释：ISR 上下文 — 必须简短！
*********************************************************************************************/
static void _touch_int_handler(uint8 pin, uint8 level, void *pdata)
{
    uint32 now;

    (void)pin;
    (void)pdata;

    /* 软件去抖 — 50ms 窗口 (按键比震动更短的去抖时间) */
    now = osal_GetSystemClock();
    if ((now - g_touch_last_time) < TOUCH_DEBOUNCE_MS) {
        return;
    }
    g_touch_last_time = now;

    /* 计数器 +1 */
    g_touch_int_count++;

    /*
     * 回调应用层:
     *   level=0 → 触摸按下 (低电平)
     *   level=1 → 触摸释放 (恢复高电平)
     */
    if (g_touch_callback != NULL) {
        g_touch_callback(level, g_touch_userdata);
    }
}


/*********************************************************************************************
* ===== 轮询模式 API (保持原有逻辑 100% 兼容) =====
*********************************************************************************************/

/*********************************************************************************************
* 名称：touch_init()
* 功能：触摸传感器初始化 (轮询模式)
* 参数：无
* 返回：无
* 修改：
* 注释：原有实现 — 配置 P0.0 为通用 IO 输入
*********************************************************************************************/
void touch_init(void)
{
    P0SEL &= ~0x01;        /* 设置管脚为通用IO模式 */
    P0DIR &= ~0x01;        /* 设置控制管脚为输入模式 */
}

/*********************************************************************************************
* 名称：get_touch_status()
* 功能：读取触摸传感器状态 (轮询模式)
* 参数：无
* 返回：TOUCH_STATE_PRESSED (1) = 有触摸, TOUCH_STATE_IDLE (0) = 无触摸
* 修改：
* 注释：原有实现 — 直接读 IO 电平
*********************************************************************************************/
unsigned char get_touch_status(void)
{
    if (P0_0) {            /* 高电平 = 未触摸 */
        return TOUCH_STATE_IDLE;
    } else {
        return TOUCH_STATE_PRESSED;
    }
}


/*********************************************************************************************
* ===== 中断模式 API (新增) =====
*********************************************************************************************/

/*********************************************************************************************
* 名称：touch_int_init()
* 功能：初始化触摸传感器为 GPIO 中断模式
* 参数：callback — 触摸事件回调
*       pdata    — 用户数据
* 返回：无
* 修改：[新增]
* 注释：
*   中断配置: P0.0, 下降沿触发 (触摸=低电平脉冲)
*   ⚠️ 与 PIR 红外共用 P0.0, 同一时刻只能一个使能！
*********************************************************************************************/
void touch_int_init(touch_event_callback_t callback, void *pdata)
{
    g_touch_callback  = callback;
    g_touch_userdata  = pdata;
    g_touch_int_count = 0;
    g_touch_last_time = 0;

    gpio_int_init_pin(TOUCH_GPIO_PIN, TOUCH_INT_EDGE,
                      _touch_int_handler, NULL);
    g_touch_int_mode  = 1;
}

/*********************************************************************************************
* 名称：touch_int_enable()
* 功能：使能触摸中断检测
* 参数：无
* 返回：无
* 修改：[新增]
*********************************************************************************************/
void touch_int_enable(void)
{
    if (g_touch_int_mode) {
        gpio_int_enable_pin(TOUCH_GPIO_PIN);
    }
}

/*********************************************************************************************
* 名称：touch_int_disable()
* 功能：禁止触摸中断检测
* 参数：无
* 返回：无
* 修改：[新增]
*********************************************************************************************/
void touch_int_disable(void)
{
    gpio_int_disable_pin(TOUCH_GPIO_PIN);
}

/*********************************************************************************************
* 名称：touch_int_get_count()
* 功能：获取触摸中断触发累计次数
* 参数：无
* 返回：累计次数
* 修改：[新增]
*********************************************************************************************/
uint16 touch_int_get_count(void)
{
    return g_touch_int_count;
}

/*********************************************************************************************
* 名称：touch_int_reset_count()
* 功能：复位触发计数器
* 参数：无
* 返回：无
* 修改：[新增]
*********************************************************************************************/
void touch_int_reset_count(void)
{
    g_touch_int_count = 0;
}
