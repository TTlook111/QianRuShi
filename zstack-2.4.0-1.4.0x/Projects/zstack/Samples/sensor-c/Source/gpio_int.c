/*********************************************************************************************
* 文件：gpio_int.c
* 作者：Lixm 2017.10.17
* 说明：CC2530 GPIO中断配置模块 — 实现
* 修改：[添加] 中断初始化、ISR、回调管理全套实现
* 注释：
*   CC2530 P0 端口中断架构:
*   ┌─────────────┬──────────────────────────────────────────┐
*   │ PICTL(0x8C) │ bit3=P0IENH, bit2=P0IENL, bit0=P0ICON    │
*   │ P0IEN(0xAB) │ 每个引脚独立中断使能位                         │
*   │ IEN1(0xE8)  │ bit5=P0IE — P0 全局中断使能                  │
*   │ P0IFG(0x89) │ 中断标志寄存器 (HW自动置位, SW写1清零)          │
*   │ IRCON(0xC0) │ bit5=P0IF — P0 中断向量标志                   │
*   └─────────────┴──────────────────────────────────────────┘
*   中断向量: P0INT_VECTOR (0x6B) — IAR 编译器自动处理
*********************************************************************************************/

/*********************************************************************************************
* 头文件
*********************************************************************************************/
#include "gpio_int.h"
#include "hal_defs.h"       /* HAL_ISR_FUNC 宏 (若存在) */

/*********************************************************************************************
* 全局变量
*********************************************************************************************/

/* 回调函数注册表 — 每个 P0 引脚最多注册一个回调 */
static gpio_int_callback_t g_p0_callbacks[8] = { NULL };
static void               *g_p0_userdata[8]   = { NULL };

/* 当前各引脚边沿配置: 0=上升沿, 1=下降沿 */
static uint8 g_p0_edge_cfg = 0;

/*********************************************************************************************
* 名称：gpio_int_read_pin()
* 功能：读取指定引脚的当前电平
* 参数：pin_mask — 单个引脚掩码
* 返回：0 = 低电平, 1 = 高电平
* 修改：
* 注释：
*********************************************************************************************/
uint8 gpio_int_read_pin(uint8 pin_mask)
{
    switch (pin_mask) {
        case GPIO_INT_PIN_P0_0: return (P0_0) ? 1 : 0;
        case GPIO_INT_PIN_P0_1: return (P0_1) ? 1 : 0;
        case GPIO_INT_PIN_P0_2: return (P0_2) ? 1 : 0;
        case GPIO_INT_PIN_P0_3: return (P0_3) ? 1 : 0;
        case GPIO_INT_PIN_P0_4: return (P0_4) ? 1 : 0;
        case GPIO_INT_PIN_P0_5: return (P0_5) ? 1 : 0;
        case GPIO_INT_PIN_P0_6: return (P0_6) ? 1 : 0;
        case GPIO_INT_PIN_P0_7: return (P0_7) ? 1 : 0;
        default:                return 0;
    }
}

/*********************************************************************************************
* 名称：_pin_mask_to_index()
* 功能：将引脚掩码转换为数组索引 (0~7)
* 参数：pin_mask — 单个引脚掩码
* 返回：数组下标, -1 表示无效
* 修改：
* 注释：内部辅助函数
*********************************************************************************************/
static int8 _pin_mask_to_index(uint8 pin_mask)
{
    switch (pin_mask) {
        case GPIO_INT_PIN_P0_0: return 0;
        case GPIO_INT_PIN_P0_1: return 1;
        case GPIO_INT_PIN_P0_2: return 2;
        case GPIO_INT_PIN_P0_3: return 3;
        case GPIO_INT_PIN_P0_4: return 4;
        case GPIO_INT_PIN_P0_5: return 5;
        case GPIO_INT_PIN_P0_6: return 6;
        case GPIO_INT_PIN_P0_7: return 7;
        default:                return -1;
    }
}

/*********************************************************************************************
* 名称：gpio_int_init_all()
* 功能：全局 GPIO 中断初始化 — 配置 P0 中断控制寄存器并清除标志
* 参数：无
* 返回：无
* 修改：
* 注释：必须在各引脚中断初始化之前调用一次
*       PICTL 默认配置: P0 下降沿触发, 使能高低组
*********************************************************************************************/
void gpio_int_init_all(void)
{
    /* 1. 清除所有 P0 中断标志 */
    P0IFG  = 0x00;                      /* 清除 P0 各引脚中断标志 */

    /* 2. 清除中断控制器标志 */
    IRCON &= ~0x20;                      /* 清除 P0IF (IRCON bit5) */

    /*
     * 3. 配置 PICTL:
     *    bit3 (P0IENH) = 1 — 使能 P0_4~P0_7 组中断
     *    bit2 (P0IENL) = 1 — 使能 P0_0~P0_3 组中断
     *    bit0 (P0ICON) = 1 — P0 下降沿触发 (默认, 各引脚可单独覆盖)
     */
    PICTL |= 0x0D;                       /* 0x0C | 0x01 = 0x0D */
    PICTL &= ~0x02;                      /* 确保 P1ICON=0 (默认上升沿),
                                            只配置 P0 的边沿 */

    /* 4. 关闭所有引脚中断使能 (逐个引脚初始化时再打开) */
    P0IEN  = 0x00;

    /* 5. 使能 P0 端口全局中断 */
    IEN1  |= 0x20;                       /* P0IE = 1 (IEN1 bit5) */

    /* 6. 使能全局中断 (EA) */
    EA     = 1;
}

/*********************************************************************************************
* 名称：gpio_int_init_pin()
* 功能：初始化指定引脚的中断配置
* 参数：pin_mask  — 引脚掩码
*       edge_type — 触发边沿 (RISING_EDGE / FALLING_EDGE)
*       callback  — 中断回调函数 (NULL = 清除回调)
*       pdata     — 用户数据
* 返回：无
* 修改：
* 注释：调用前需先调用 gpio_int_init_all()
*       不同引脚可配置不同边沿 — 但 CC2530 限制所有 P0 引脚共享边沿类型
*       本实现采用下降沿统一配置，回调中通过读引脚电平实现双边沿效果
*********************************************************************************************/
void gpio_int_init_pin(uint8 pin_mask, uint8 edge_type,
                       gpio_int_callback_t callback, void *pdata)
{
    int8 idx = _pin_mask_to_index(pin_mask);
    if (idx < 0) return;

    /* 1. 注册回调函数和用户数据 */
    g_p0_callbacks[idx] = callback;
    g_p0_userdata[idx]  = pdata;

    /* 2. 记录边沿配置 (供 ISR 使用) */
    if (edge_type == GPIO_INT_FALLING_EDGE) {
        g_p0_edge_cfg |= pin_mask;       /* bit=1 表示下降沿 */
    } else {
        g_p0_edge_cfg &= ~pin_mask;      /* bit=0 表示上升沿 */
    }

    /*
     * 3. 配置引脚为通用 IO 输入模式
     *    这是 CC2530 GPIO 中断的前提条件:
     *    - PxSEL &= ~bit → 通用 IO (非外设)
     *    - PxDIR &= ~bit → 输入方向
     */
    P0SEL &= ~pin_mask;
    P0DIR &= ~pin_mask;

    /* 4. 使能该引脚中断 */
    P0IEN |= pin_mask;
}

/*********************************************************************************************
* 名称：gpio_int_enable_pin()
* 功能：使能指定引脚的中断
* 参数：pin_mask — 引脚掩码
* 返回：无
* 修改：
* 注释：恢复之前被 gpio_int_disable_pin() 禁止的中断
*********************************************************************************************/
void gpio_int_enable_pin(uint8 pin_mask)
{
    P0IEN  |= pin_mask;                  /* 使能该引脚中断 */
    P0IFG  &= ~pin_mask;                 /* 清除可能残留的中断标志 */
}

/*********************************************************************************************
* 名称：gpio_int_disable_pin()
* 功能：禁止指定引脚的中断
* 参数：pin_mask — 引脚掩码
* 返回：无
* 修改：
* 注释：临时屏蔽中断 (如防止抖动时使用)
*********************************************************************************************/
void gpio_int_disable_pin(uint8 pin_mask)
{
    P0IEN  &= ~pin_mask;                 /* 禁止该引脚中断 */
    P0IFG  &= ~pin_mask;                 /* 清除中断标志 */
}

/*********************************************************************************************
* 名称：P0_ISR()
* 功能：P0 端口中断服务程序
* 参数：无
* 返回：无
* 修改：
* 注释：
*   CC2530 P0 中断向量地址: 0x6B
*   IAR 编译器 #pragma vector = P0INT_VECTOR 自动注册
*
*   中断处理流程:
*   1. 读取 P0IFG 获取触发中断的引脚
*   2. 读取引脚当前电平
*   3. 查找并调用注册的回调函数
*   4. 清除 P0IFG 标志位
*   5. 清除 IRCON 中的 P0IF 标志
*
*   ⚠️ ISR 中禁止耗时操作 (调用的回调也应尽量简短)
*********************************************************************************************/
#pragma vector = P0INT_VECTOR
__interrupt void P0_ISR(void)
{
    uint8 ifg;                           /* 中断标志副本 */
    uint8 pin_mask;
    uint8 pin_level;
    int8  i;

    /* 1. 读取中断标志 — 哪个引脚触发了中断 */
    ifg = P0IFG;

    /* 2. 遍历所有 8 个引脚，处理触发中断的引脚 */
    for (i = 0; i < 8; i++) {
        pin_mask = (uint8)(1 << i);

        if (ifg & pin_mask) {

            /* 3. 读取当前引脚电平 */
            pin_level = gpio_int_read_pin(pin_mask);

            /*
             * 4. 边沿过滤:
             *    - 配置为下降沿但当前为高 → 可能是反弹噪声, 跳过
             *    - 配置为上升沿但当前为低 → 同理跳过
             */
            if ((g_p0_edge_cfg & pin_mask) && pin_level == 1) {
                /* 下降沿配置, 但当前为高 — 忽略 */
            } else if (!(g_p0_edge_cfg & pin_mask) && pin_level == 0) {
                /* 上升沿配置, 但当前为低 — 忽略 */
            } else {
                /* 5. 边沿匹配, 调用回调 */
                if (g_p0_callbacks[i] != NULL) {
                    g_p0_callbacks[i]((uint8)i, pin_level, g_p0_userdata[i]);
                }
            }

            /* 6. 清除该引脚的中断标志 (写 1 清零) */
            P0IFG &= ~pin_mask;
        }
    }

    /* 7. 清除 P0 端口中断标志 */
    IRCON &= ~0x20;                       /* P0IF = 0 */
}
