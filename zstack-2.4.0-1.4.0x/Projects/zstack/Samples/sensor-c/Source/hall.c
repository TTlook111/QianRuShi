/*********************************************************************************************
* 文件：hall.c
* 作者：Lixm 2017.10.17
* 说明：REED门磁/霍尔传感器驱动 — 实现
* 修改：[增强] 新增 GPIO 中断模式:
*          - hall_int_init()    中断初始化
*          - hall_int_enable()  中断使能
*          - hall_int_disable() 中断禁止
*          - 门状态变化 ISR 回调 实时推送门开关事件
* 注释：
*   霍尔门磁工作原理:
*   - 门框上安装磁铁，门上安装霍尔传感器模块
*   - 门闭合: 磁铁靠近霍尔 → 霍尔输出低电平 (DOOR_STATE_CLOSED)
*   - 门打开: 磁铁远离霍尔 → 霍尔输出高电平 (DOOR_STATE_OPEN)
*
*   接线:
*   霍尔 VCC  → CC2530 3.3V
*   霍尔 GND  → CC2530 GND
*   霍尔 OUT  → CC2530 P0.2
*
*   安防场景:
*   - 门被非法打开 → 上升沿中断 → 立即上报告警
*   - 门闭合 → 下降沿中断 → 上报门已关闭
*********************************************************************************************/

/*********************************************************************************************
* 头文件
*********************************************************************************************/
#include "hall.h"
#include "OSAL.h"        /* osal_GetSystemClock() */

/*********************************************************************************************
* 全局变量
*********************************************************************************************/

/* 中断模式状态 */
static door_event_callback_t g_door_callback  = NULL;
static void                 *g_door_userdata  = NULL;
static volatile uint16       g_hall_int_count = 0;
static volatile uint32       g_hall_last_time = 0;
static volatile uint8        g_hall_int_mode  = 0;

/*********************************************************************************************
* 名称：_hall_int_handler()
* 功能：霍尔传感器中断内部处理函数 (由 gpio_int ISR 回调)
* 参数：pin    — 触发引脚索引 (2)
*       level  — 当前引脚电平
*       pdata  — 用户数据
* 返回：无
* 修改：[新增]
* 注释：ISR 上下文 — 必须简短！
*********************************************************************************************/
static void _hall_int_handler(uint8 pin, uint8 level, void *pdata)
{
    uint32 now;

    (void)pin;
    (void)pdata;

    /* 软件去抖 — 100ms 窗口 */
    now = osal_GetSystemClock();
    if ((now - g_hall_last_time) < HALL_DEBOUNCE_MS) {
        return;
    }
    g_hall_last_time = now;

    /* 计数器 +1 */
    g_hall_int_count++;

    /*
     * 回调应用层:
     *   level=0 → 门闭合 (DOOR_STATE_CLOSED)
     *   level=1 → 门打开 (DOOR_STATE_OPEN)
     */
    if (g_door_callback != NULL) {
        g_door_callback(level, g_door_userdata);
    }
}


/*********************************************************************************************
* ===== 轮询模式 API (保持原有逻辑 100% 兼容) =====
*********************************************************************************************/

/*********************************************************************************************
* 名称：hall_init()
* 功能：霍尔传感器初始化 (轮询模式)
* 参数：无
* 返回：无
* 修改：
* 注释：原有实现 — 配置 P0.2 为通用 IO 输入
*********************************************************************************************/
void hall_init(void)
{
    P0SEL &= ~0x04;        /* 设置管脚为通用IO模式 */
    P0DIR &= ~0x04;        /* 设置控制管脚为输入模式 */
}

/*********************************************************************************************
* 名称：get_hall_status()
* 功能：读取霍尔传感器状态 (轮询模式)
* 参数：无
* 返回：DOOR_STATE_OPEN (1) = 门打开, DOOR_STATE_CLOSED (0) = 门闭合
* 修改：
* 注释：原有实现 — P0.2 低电平表示门闭合
*********************************************************************************************/
unsigned char get_hall_status(void)
{
    if (P0_2)              /* 霍尔传感器输出高电平 → 门打开 */
        return DOOR_STATE_OPEN;     /* 没有检测到信号返回 0 (门闭合) */
    else
        return DOOR_STATE_CLOSED;   /* 检测到信号返回 1 (门打开) */
}


/*********************************************************************************************
* ===== 中断模式 API (新增) =====
*********************************************************************************************/

/*********************************************************************************************
* 名称：hall_int_init()
* 功能：初始化霍尔传感器为 GPIO 中断模式
* 参数：callback — 门状态变化回调
*       pdata    — 用户数据
* 返回：无
* 修改：[新增]
* 注释：
*   中断配置: P0.2, 下降沿触发
*   CC2530 限制 P0 所有引脚共享边沿类型 (PICTL bit0),
*   但可配合 P0IEN 独立使能。本模块使用 P0IEN bit2。
*********************************************************************************************/
void hall_int_init(door_event_callback_t callback, void *pdata)
{
    g_door_callback  = callback;
    g_door_userdata  = pdata;
    g_hall_int_count = 0;
    g_hall_last_time = 0;

    gpio_int_init_pin(HALL_GPIO_PIN, HALL_INT_EDGE,
                      _hall_int_handler, NULL);
    g_hall_int_mode  = 1;
}

/*********************************************************************************************
* 名称：hall_int_enable()
* 功能：使能门磁中断检测
* 参数：无
* 返回：无
* 修改：[新增]
*********************************************************************************************/
void hall_int_enable(void)
{
    if (g_hall_int_mode) {
        gpio_int_enable_pin(HALL_GPIO_PIN);
    }
}

/*********************************************************************************************
* 名称：hall_int_disable()
* 功能：禁止门磁中断检测
* 参数：无
* 返回：无
* 修改：[新增]
*********************************************************************************************/
void hall_int_disable(void)
{
    gpio_int_disable_pin(HALL_GPIO_PIN);
}

/*********************************************************************************************
* 名称：hall_int_get_count()
* 功能：获取霍尔中断触发累计次数
* 参数：无
* 返回：累计次数
* 修改：[新增]
*********************************************************************************************/
uint16 hall_int_get_count(void)
{
    return g_hall_int_count;
}

/*********************************************************************************************
* 名称：hall_int_reset_count()
* 功能：复位触发计数器
* 参数：无
* 返回：无
* 修改：[新增]
*********************************************************************************************/
void hall_int_reset_count(void)
{
    g_hall_int_count = 0;
}
