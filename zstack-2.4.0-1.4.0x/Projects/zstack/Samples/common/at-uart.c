/*********************************************************************************************
* 文件：at-uart.c
* 作者：Xuzhy 2018.5.16
* 说明：节点AT指令串口初始化
* 修改：fuyou 增加透传驱动
* 注释：
*********************************************************************************************/

/*********************************************************************************************
* 头文件
*********************************************************************************************/
#include <iocc2530.h>
#include <stdio.h>
#include "hal_mcu.h"
#include "at-uart.h"
#include "math.h"
/*********************************************************************************************
* 宏定义
*********************************************************************************************/
#define SUPPOER_DEBUG 1
/*********************************************************************************************
* 函数原型说明
*********************************************************************************************/
static void (*_input)(char ch);
/*********************************************************************************************
* 名称：UART_BuadCount
* 功能：串口波特率计算
* 参数：baud:波特率
* 返回：无
* 修改：
* 注释：根据波特率计算寄存器值
*********************************************************************************************/
void UART_BuadCount(double* baud,char* baud_e,char* baud_m)
{
	double sys_clk_baud = 32000000.0;							//系统时钟
	
	/*根据波特率选择baud_e*/
	if(*baud<4800)
	{
		*baud_e = 6;
	}
	else if((*baud>=4800)&&(*baud<9600))
	{
		*baud_e = 7;
	}
	else if((*baud>=9600)&&(*baud<19200))
	{
		*baud_e = 8;
	}
	else if((*baud>=19200)&&(*baud<38400))
	{
		*baud_e = 9;
	}
	else if((*baud>=38400)&&(*baud<76800))
	{
		*baud_e = 10;
	}
	else if((*baud>=76800)&&(*baud<230400))
	{
		*baud_e = 11;
	}
	else
	{
		*baud_e = 12;
	}
	
	/*计算baud_m*/
	*baud_m = (char)((((*baud)*pow(2,28))/(sys_clk_baud*pow(2,*baud_e)))-256.0);
}
/*********************************************************************************************
* 名称：uart0Init
* 功能：uart0初始化，复用到位置1
* 参数：baud:波特率
* 返回：无
* 修改：
* 注释：
*********************************************************************************************/
void uart0Init(double baud)
{
	char baud_e,baud_m;
	
	P0SEL |=  0x0C;                 							//初始化UART0端口
	PERCFG&= ~0x01;                 							//选择UART0为可选位置一
	P0DIR &= ~(1<<2);                 							//P02,IN
	P0DIR |= (1<<3);                 							//PO3,OUT
	P2DIR &= ~0xC0;                 							//P0优先作为串口0
	
	U0CSR = 0xC0;                   							//设置为UART模式,而且使能接受器
	UART_BuadCount(&baud,&baud_e,&baud_m);						//计算波特率
	U0GCR = baud_e;                  
	U0BAUD = baud_m;                  							//设置波特率
    
    //设置中断优先级最高
    //IP0 |= (1<<2);
    //IP1 |= (1<<2);
    
	URX0IE = 1;													//串口接收中断使能
	//EA = 1;														//开总中断
}
/*********************************************************************************************
* 名称：uart1Init
* 功能：uart1初始化，复用到位置2
* 参数：baud:波特率
* 返回：无
* 修改：
* 注释：
*********************************************************************************************/
void uart1Init(double baud)
{
	char baud_e,baud_m;
	
	/*UART1，IO初始化,P16,P17*/
	P1SEL |= ((1<<6)|(1<<7));									//选择IO功能为外设
	PERCFG |= (1<<1);											//选择复用到位置2
	P1DIR &= ~(1<<7);											//设置P17为输入
	P1DIR |= (1<<6);											//设置P16为输出
    
	/*UART初始化*/
	U1CSR = ((1<<7)|(1<<6));									//设置为UART模式,使能接收
	UART_BuadCount(&baud,&baud_e,&baud_m);						//计算波特率
	U1GCR = baud_e;
	U1BAUD = baud_m;											//设置波特率
    
    //设置中断优先级最高
    //IP0 |= (1<<3);
    //IP1 |= (1<<3);
    
	URX1IE = 1;													//串口接收中断使能
	//EA = 1;														//开总中断
}
/*********************************************************************************************
* 名称：Uart0SendByte
* 功能：串口0发送字节函数
* 参数：ch:要发送的字节
* 返回：无
* 修改：
* 注释：
*********************************************************************************************/
void Uart0SendByte(unsigned char ch)
{
  /*
	U0DBUF = ch;
	while(UTX0IF == 0);
	UTX0IF = 0;
  */
       U0DBUF = ch;
     while((U0CSR&0x02) == 0);
     U0CSR = U0CSR&~0x02;
}
/*********************************************************************************************
* 名称：Uart1SendByte
* 功能：串口1发送字节函数
* 参数：ch:要发送的字节
* 返回：无
* 修改：
* 注释：
*********************************************************************************************/
void Uart1SendByte(unsigned char ch)
{
	/*U1DBUF = ch;
	while(UTX1IF == 0);
	UTX1IF = 0;*/
     U1DBUF = ch;
     while(U1TX_BYTE == 0);
     U1TX_BYTE = 0;
}
/*********************************************************************************************
* 名称：at_uart_init()
* 功能：节点AT指令串口初始化
* 参数：
* 返回：
* 修改：
* 注释：
*********************************************************************************************/
void at_uart_init(void)
{
#if defined(CC2530_Serial)
    uart0Init(38400);
#else
    uart1Init(38400);
#endif
}
/*********************************************************************************************
* 名称：at_uart_write()
* 功能：节点AT指令串口写数据
* 参数：
* 返回：
* 修改：
* 注释：
*********************************************************************************************/
void at_uart_write(char ch)
{
#if defined(CC2530_Serial)
    Uart0SendByte(ch);
#else
    Uart1SendByte(ch);
#endif
}
/*********************************************************************************************
* 名称：at_uart_set_input_call()
* 功能：节点AT指令串口读数据
* 参数：
* 返回：
* 修改：
* 注释：
*********************************************************************************************/
void at_uart_set_input_call(void (*c)(char ch))
{
  _input = c;
}
/*********************************************************************************************
* 名称：HAL_ISR_FUNCTION()
* 功能：节点AT指令串口中断处理
* 参数：
* 返回：
* 修改：
* 注释：
*********************************************************************************************/
#if defined(CC2530_Serial)
HAL_ISR_FUNCTION(halUart0TxIsr, URX0_VECTOR)
{
    char ch;
    ch = U0DBUF;
    if (_input != NULL) {
      _input(ch);
    }
}
#else
HAL_ISR_FUNCTION(halUart1TxIsr, URX1_VECTOR)
{
  char ch;
    ch = U1DBUF;
    if (_input != NULL) {
      _input(ch);
    }
}
#endif
/*********************************************************************************************
* 名称：putchar()
* 功能：printf iar 调试接口
* 参数：
* 返回：
* 修改：
* 注释：
*********************************************************************************************/
#if  SUPPOER_DEBUG
__near_func int  putchar(int ch) 
{
  at_uart_write(ch);
  return ch;
}
#endif