/*********************************************************************************************
* 文件：sensor.c
* 作者：Xuzhy 2018.5.16
* 说明：节点工程驱动模版
*       智慧农业系统三种类型设备：采集类（光照度采集）、安防类（光照强度阀值报警状态）、控制类（遮阳电机）
*       数据包格式：{lightIntensity=124.0,lightIntensityStatus=0,mortorStatus=0}
*       lightIntensity表示光强值，lightIntensityStatus为光强报警阀值（0/1），motorStatus为遮阳电机的状态（ON/OFF）
*       查询命令：查询数值参考（比如查询当前光强度：{lightIntensity=?}）
*       控制命令：cmd=0为关闭遮阳电机，cmd=1为打开电机
* 修改：修复指令查询后数据不实时上报问题
* 注释：
*********************************************************************************************/

/*********************************************************************************************
* 头文件
*********************************************************************************************/
#include <stdio.h>
#include <stdlib.h>
#include <string.h>
#include "sapi.h"
#include "osal_nv.h"
#include "addrmgr.h"
#include "mt.h"
#include "hal_led.h"
#include "hal_adc.h"
#include "hal_uart.h"
#include "sensor.h"
#include "BH1750.h"
#include "iic.h"
#include "zxbee.h"
#include "zxbee-inf.h"
/*********************************************************************************************
* 宏定义
*********************************************************************************************/

/*********************************************************************************************
* 全局变量
*********************************************************************************************/
static float lightIntensity = 0.0;                              // 光照强度值
/*********************************************************************************************
* 名称：updatelightIntensity()
* 功能：更新光强值
* 参数：
* 返回：
* 修改：
* 注释：
*********************************************************************************************/
void updateLightIntensity(void)
{
  //读取光照强度值
  lightIntensity = bh1750_get_data();
}
/*********************************************************************************************
* 名称：sensorInit()
* 功能：传感器硬件初始化
* 参数：无
* 返回：无
* 修改：
* 注释：
*********************************************************************************************/
void sensorInit(void)
{
  bh1750_init();
  //启动定时器，触发传感器上报数据事件：MY_REPORT_EVT
  osal_start_timerEx(sapi_TaskID,MY_REPORT_EVT,(uint16)((osal_rand()%10) * 1000));
}
/*********************************************************************************************
* 名称：sensorLinkOn()
* 功能：传感器节点入网成功调用函数
* 参数：无
* 返回：无
* 修改：
* 注释：
*********************************************************************************************/
void sensorLinkOn(void)
{
  sensorUpdate();
}
/*********************************************************************************************
* 名称：sensorUpdate()
* 功能：处理主动上报的数据
* 参数：无
* 返回：无
* 修改：
* 注释：
*********************************************************************************************/
void sensorUpdate(void)
{
  char pData[16];
  char *p = pData;
  
  //光照度采集
  updateLightIntensity();
  
  ZXBeeBegin();
  
  //上报光照值
  sprintf(p,"%.1f",lightIntensity);
  ZXBeeAdd("lightIntensity",p);
  
  p = ZXBeeEnd();
  if(p != NULL){
    ZXBeeInfSend(p,strlen(p));
  }
}
/*********************************************************************************************
* 名称：ZXBeeUserProcess()
* 功能：解析收到的控制命令
* 参数：无
* 返回：无
* 修改：
* 注释：
*********************************************************************************************/
int ZXBeeUserProcess(char *ptag,char *pval)
{
  int ret = 0;
  char pData[16];
  char *p = pData;
  
  //控制命令解析
  if(0 == strcmp("lightIntensity",ptag)){
    if(0 == strcmp("?",pval)){
      updateLightIntensity();
      ret = sprintf(p,"%.1f",lightIntensity);
      ZXBeeAdd("lightIntensity",p);

      // ========== 修复代码：实时发送数据到云端 ==========
      char *sendBuf = ZXBeeEnd();
      if(sendBuf != NULL){
        ZXBeeInfSend(sendBuf, strlen(sendBuf));
      }
    }
  }
  
  return ret;
}
/*********************************************************************************************
* 名称：MyEventProcess()
* 功能：自定义事件处理
* 参数：无
* 返回：无
* 修改：
* 注释：
*********************************************************************************************/
void MyEventProcess(uint16 event)
{
  if(event & MY_REPORT_EVT){
    sensorUpdate();
    //启动定时器，触发事件
    osal_start_timerEx(sapi_TaskID,MY_REPORT_EVT,20*1000);
  }
}